## boards/arm/akdk_bt1/akdk_bt1/Kconfig.akdk_bt1
```kconfig
# SPDX-License-Identifier: MIT

config BOARD_AKDK_BT1
	bool "akdk_bt1"
	select on SOC_NRF52840_QIAA
```

## boards/shields/minima40_v2/Kconfig.defconfig
```kconfig
if SHIELD_MINIMA40_V2

config ZMK_KEYBOARD_NAME
    default "minima40_v2"

endif
```
